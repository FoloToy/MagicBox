## boards/m301-c5-rtc-v1-5g/esp-idf/sdkconfig.defaults
```kconfig
# M301 C5 RTC-v1-5G source profile; physical PCB revision pending.
CONFIG_IDF_TARGET="esp32c5"
CONFIG_ESPTOOLPY_FLASHMODE_QIO=y
CONFIG_ESPTOOLPY_FLASHSIZE_16MB=y
CONFIG_PARTITION_TABLE_CUSTOM=y
CONFIG_PARTITION_TABLE_CUSTOM_FILENAME="partitions.csv"
CONFIG_PARTITION_TABLE_FILENAME="partitions.csv"

CONFIG_SPIRAM=y
CONFIG_SPIRAM_MODE_QUAD=y
CONFIG_SPIRAM_SPEED_80M=y
CONFIG_SPIRAM_MEMTEST=y
CONFIG_SPIRAM_MALLOC_RESERVE_INTERNAL=32768

CONFIG_FREERTOS_HZ=1000
CONFIG_ESP_MAIN_TASK_STACK_SIZE=5120
CONFIG_ESP_CONSOLE_SECONDARY_USB_SERIAL_JTAG=y
CONFIG_ESP_COREDUMP_ENABLE_TO_NONE=y

# Required by folotoy-firmware-driver's AXP2101/GX8002 adapters.
CONFIG_I2C_COMMUNICATION_METHOD_BUILTIN_RW=y
CONFIG_SENSORLIB_ESP_IDF_NEW_API=y
CONFIG_XPOWERS_ESP_IDF_NEW_API=y
CONFIG_SENSOR_PMIC_SUPPORT=y
```

## main/boards/m09-s3-hw210/Kconfig.board
```kconfig
config BOARD_TYPE_FOLOTOY_MAGICBOX_M09_S3_HW210
    bool "MagicBox m09-s3-hw210"
    depends on IDF_TARGET_ESP32S3
```

## main/boards/m301-c5-rtc-v1-5g/Kconfig.board
```kconfig
config BOARD_TYPE_FOLOTOY_MAGICBOX_M301_C5_RTC_V1_5G
    bool "MagicBox m301-c5-rtc-v1-5g"
    depends on IDF_TARGET_ESP32C5
```
